## prj.conf
```kconfig
# Logger module
CONFIG_LOG=y

# Button and LED library   
CONFIG_DK_LIBRARY=y

# ADC library
CONFIG_ADC=y

# math.h, pow and sqrt functions
CONFIG_NEWLIB_LIBC=y

#Enabloi floattien käyttö printk:ssa
CONFIG_CBPRINTF_FP_SUPPORT=y
```

## src/main.c
```c
/*
 * Copyright (c) 2020 Libre Solar Technologies GmbH
 *
 * SPDX-License-Identifier: Apache-2.0
 */
#include <zephyr/logging/log.h>
#include <dk_buttons_and_leds.h>
#include <inttypes.h>
#include <stddef.h>
#include <stdint.h>
#include <zephyr/kernel.h>
#include <zephyr/sys/printk.h>
#include <zephyr/sys/util.h>
#include "adc.h"
#include <zephyr/device.h>
#include <zephyr/devicetree.h>

#include "confusion.h"
//#include "neuroverkonKertoimet.h"



#define USER_LED1         	 	DK_LED1
#define USER_LED2          		DK_LED2
#define USER_LED3               DK_LED3
#define USER_LED4               DK_LED4

#define USER_BUTTON_1           DK_BTN1_MSK
#define USER_BUTTON_2           DK_BTN2_MSK
#define USER_BUTTON_3           DK_BTN3_MSK
#define USER_BUTTON_4           DK_BTN4_MSK

#define DEBUG 0  // 0 = changes direction when button 3 is pressed
                 // 1 = fake 100 measurements done to each 6 directions when 3 pressed.
static int direction = -1;	// 0 = x direction high
							// 1 = x directon low	
							// 2 = y direction high
							// 3 = y direction low
							// 4 = z direction high
							// 5 = z direction low
                				 

LOG_MODULE_REGISTER(MAIN, LOG_LEVEL_INF);

int state = 0; // 0 = k-means, 1 = neural network

static void button_changed(uint32_t button_state, uint32_t has_changed)
{
	//printk("button_state = %d\n",button_state);
	//printk("has_changed = %d\n",has_changed);
	if ((has_changed & USER_BUTTON_1) && (button_state & USER_BUTTON_1)) 
	{
		printk("Button 1 down, changing current state:\n");
		if(state == 0)
		{
			state = 1;
			printk("Classification is done with neural network\n");
		}
		else
		{
			state = 0;
			printk("Classification is done with k-means\n");
		}
		//printk("Button 1 down, printing current Confusion Matrix\n");
		//printConfusionMatrix();
	}

	if ((has_changed & USER_BUTTON_2) && (button_state & USER_BUTTON_2)) 
	{
		printk("Button 2 down, resetting confusion matrix\n");
		resetConfusionMatrix(state);
		printConfusionMatrix();
	}		
	
	if ((has_changed & USER_BUTTON_3) && (button_state & USER_BUTTON_3)) 
	{
		printk("Button 3 down, making fake 100 meas or one real meas depending on DEBUG state\n");
		#if DEBUG
		direction = 0;
		makeHundredFakeClassifications();
		printConfusionMatrix();
		#else
        direction = (direction +1)%6;
		switch (direction)
		{
		case 0:
			printk("Direction is now set x = low\n");
			break;
		case 1:
			printk("Direction is now set x = high\n");
			break;
		case 2:
			printk("Direction is now set y = low\n");
			break;
		case 3:
			printk("Direction is now set y = high\n");
			break;
		case 4:
			printk("Direction is now set z = low\n");
			break;
		case 5:
			printk("Direction is now set z = high\n");
			break;
		
		default:
		    printk("Wrong direction set!!!\n");
			break;
		}

		struct Measurement m = readADCValue();
		printk("x = %d,  y = %d,  z = %d\n",m.x,m.y,m.z);
		#endif
	}		

	if ((has_changed & USER_BUTTON_4) && (button_state & USER_BUTTON_4)) 
	{
		
		printk("button 4 down, one meas and classification with current direction =%d\n",direction);		

		for(int i = 0; i < 100; i++)
		{
			if(state == 0)
			{
				makeOneClassificationAndUpdateConfusionMatrix(direction);
			}
			else
			{
				makeClassificationWithNeuralNetwork(direction);
			}
		}
		printConfusionMatrix();
	}		
}

void main(void)
{
	
	
	/*	
	//Lasketaan softmax(a2) TOIMII
    float max = -__FLT_MAX__; //alustus pienimmällä float luvulla (=suurin negatiivinen luku)
    float sum = 0;

    // Etsitään suurin arvo
    for (int i = 0; i < w2Cols; i++) {
        if (a2[i] > max) {
            max = a2[i];
        }
    }

    // Vähennetään suurin arvo ja lasketaan e:n potenssiin x jokaiselle x:n alkiolle
    // Laske näiden summa
    for (int i = 0; i < w2Cols; i++) {
        a2[i] = exp(a2[i] - max);	//Vähennetään suurin arvo vektorista ennen e:n potenssiin laskemista (estää ylivuodon)
        sum = sum + a2[i];
    }

    // Jaa jokainen alkio summan arvolla
    for (int i = 0; i < w2Cols; i++) {
        a2[i] = a2[i] / sum;
    }
	printk("\nTulos softmax laskun jälkeen:\n");
	for (int i = 0; i < w2Cols; ++i) 
	{
		printk("%f ", a2[i]);
	}
	*/

	/*//RELU TESTI TOIMII
	int relu_array[] = {1, 2, 3, -1, -2, -3};
    int size = sizeof(relu_array) / sizeof(relu_array[0]);
	printk("Arrayn koko on %d",size);
    printk("Alkuperäinen taulukko:\n");
    for (int i = 0; i < size; ++i) {
        printk("%d ", relu_array[i]);
    }
    printk("\n");

    // Kutsutaan relu-funktiota
    relu(relu_array, size);

    printk("Muutettu taulukko:\n");
    for (int i = 0; i < size; ++i) {
        printk("%d ", relu_array[i]);
    }
    printk("\n");
	*/



	int err;
	err = dk_leds_init();
	if (err) {
		LOG_ERR("LEDs init failed (err %d)\n", err);
		return;
	}

	err = dk_buttons_init(button_changed);
	if (err) {
		printk("Cannot init buttons (err: %d)\n", err);
		return;
	}
	
	
	if(initializeADC() != 0)
	{
	printk("ADC initialization failed!");
	return;
	}

	while (1) 
	{
		//struct Measurement m = readADCValue();
		//printk("x = %d,  y = %d,  z = %d\n",m.x,m.y,m.z);
		if(state == 0)
		{
			k_sleep(K_MSEC(1000));
			
			dk_set_led_on(USER_LED1);
			dk_set_led_on(USER_LED2);
			dk_set_led_on(USER_LED3);
			dk_set_led_on(USER_LED4);
			
			k_sleep(K_MSEC(1000));
			
			dk_set_led_off(USER_LED1);
			dk_set_led_off(USER_LED2);
			dk_set_led_off(USER_LED3);
			dk_set_led_off(USER_LED4);
		}
		else
		{
			k_sleep(K_MSEC(100));
			
			dk_set_led_on(USER_LED1);
			k_sleep(K_MSEC(100));
			dk_set_led_off(USER_LED1);
			dk_set_led_on(USER_LED2);
			k_sleep(K_MSEC(100));
			dk_set_led_off(USER_LED2);
			dk_set_led_on(USER_LED3);
			k_sleep(K_MSEC(100));
			dk_set_led_off(USER_LED3);
			dk_set_led_on(USER_LED4);
			k_sleep(K_MSEC(100));
			dk_set_led_off(USER_LED4);
		}

	}
}
```

## src/confusion.c
```c
#include <zephyr/kernel.h>
#include <math.h>
#include "confusion.h"
#include "adc.h"
#include "keskipisteet.h"
#include "neuroverkonKertoimet.h"
#include <time.h>

/* 
  K-means algorithm should provide 6 center points with
  3 values x,y,z. Let's test measurement system with known
  center points. I.e. x,y,z are supposed to have only values
  1 = down and 2 = up
  
  CP matrix is thus the 6 center points got from K-means algoritm
  teaching process. This should actually come from include file like
  #include "KmeansCenterPoints.h"
  
  And measurements matrix is just fake matrix for testing purpose
  actual measurements are taken from ADC when accelerator is connected.
*/ 
#define DEBUG 0

int CP[6][3]={
	                     {1,0,0},
						 {2,0,0},
						 {0,1,0},
						 {0,2,0},
						 {0,0,1},
						 {0,0,2}
};

int measurements[6][3]={
	                     {1,0,0},
						 {2,0,0},
						 {0,1,0},
						 {0,2,0},
						 {0,0,1},
						 {0,0,2}
};

int CM[6][6]= {0};

int CM2[6][6]= {0};

//relu ja softmax funktiot
void relu(float *array, int size) 
{
    for (int i = 0; i < size; ++i) 
	{
        if (array[i] < 0) {
            array[i] = 0;
        }
    }
}
void softmax(float* x, int length) {
    float max = -__FLT_MAX__; //alustus pienimmällä float luvulla (=suurin negatiivinen luku)
    float sum = 0;

    // Etsitään suurin arvo
    for (int i = 0; i < length; i++) {
        if (x[i] > max) {
            max = x[i];
        }
    }

    // Vähennetään suurin arvo ja lasketaan e:n potenssiin x jokaiselle x:n alkiolle
    // Laske näiden summa
    for (int i = 0; i < length; i++) {
        x[i] = exp(x[i] - max);	//Vähennetään suurin arvo vektorista ennen e:n potenssiin laskemista (estää ylivuodon)
        sum = sum + x[i];
    }

    // Jaa jokainen alkio summan arvolla
    for (int i = 0; i < length; i++) {
        x[i] = x[i] / sum;
    }
}

void makeClassificationWithNeuralNetwork(int direction)
{
   struct Measurement m = readADCValue();
   float a0[3] = {m.x, m.y, m.z}; //input data
   //float a0[3] = {1200,1500,1500};
	float a1[10] = {0};	//hidden layer
	float a2[6] = {0}; //output layer
	int a0Rows = 3;
	int w1Cols = 10;
	int w2Cols = 6;

	//Lasketaan matmul a0 * W1
	for (int i = 0; i < w1Cols; ++i) 
	{
		for (int j = 0; j < a0Rows; ++j) 
		{
			a1[i] = a1[i] + a0[j] * W1[j][i];
		}
	}
   //Lasketaan a1 + b1
	for (int i = 0; i < w1Cols; ++i) 
	{
		a1[i] = a1[i] + B1[i];
	}
   //Lasketeaan relu(a1)
	relu(a1, w1Cols);

	for (int i = 0; i < w2Cols; ++i) 
	{
		for (int j = 0; j < w1Cols; ++j) 
		{
			a2[i] = a2[i] + a1[j] * W2[j][i];
		}
	}
	for (int i = 0; i < w2Cols; ++i) 
	{
		a2[i] = a2[i] + B2[i];
	}
   //Lasketaan a2 + b2
	for (int i = 0; i < w2Cols; ++i) 
	{
		a2[i] = a2[i] + B2[i];
	}
   //Lasketaan softmax(a2)
	softmax(a2, w2Cols);

   //Lasketaan voittaja eli se indeksi, jolla on suurin arvo
   int winnerIndex = 0;
   float max = -__FLT_MAX__; //alustus pienimmällä float luvulla (=suurin negatiivinen luku)
   for (int i = 0; i < w2Cols; i++) {
        if (a2[i] > max) { //Etsitään suurin arvo
            max = a2[i]; //Tallennetaan suurin arvo
            winnerIndex = i;
        }
    }
   printk("\nVoittaja = %d\n", winnerIndex + 1);
   CM2[direction][winnerIndex]++; //Kasvatetaan suunnan ja voittajan indeksin mukaista solua yhdellä
}

void printConfusionMatrix(void)
{
	printk("Confusion matrix (k-means) = \t");
   printk("Confusion matrix (neural network) = \n");
	printk("   cp1 cp2 cp3 cp4 cp5 cp6\t");
   printk("   cp1 cp2 cp3 cp4 cp5 cp6\n");
	for(int i = 0;i<6;i++)
	{
		printk("cp%d %d   %d   %d   %d   %d   %d\t",i+1,CM[i][0],CM[i][1],CM[i][2],CM[i][3],CM[i][4],CM[i][5]);
      printk("cp%d %d   %d   %d   %d   %d   %d\n",i+1,CM2[i][0],CM2[i][1],CM2[i][2],CM2[i][3],CM2[i][4],CM2[i][5]);
	}
}

void makeHundredFakeClassifications(void)
{
   /*******************************************
   Jos ja toivottavasti kun teet toteutuksen paloissa eli varmistat ensin,
   että etäisyyden laskenta 6 keskipisteeseen toimii ja osaat valita 6 etäisyydestä
   voittajaksi sen lyhyimmän etäisyyden, niin silloin voit käyttää tätä aliohjelmaa
   varmistaaksesi, että etäisuuden laskenta ja luokittelu toimii varmasti tunnetulla
   itse keksimälläsi sensoridatalla ja itse keksimilläsi keskipisteillä.
   *******************************************/
   for(int i = 0; i < 100; i++)
   {
      for(int j = 0; j < 6; j++)
      {
         int winnerIndex = calculateDistanceToAllCentrePointsAndSelectWinner(measurements[j][0], measurements[j][1], measurements[j][2]);
         CM[j][winnerIndex]++; //Kasvatetaan suunnan ja voittajan indeksin mukaista solua yhdellä
      }

   }
}

void makeOneClassificationAndUpdateConfusionMatrix(int direction)
{
   /**************************************
   Tee toteutus tälle ja voit tietysti muuttaa tämän aliohjelman sellaiseksi,
   että se tekee esim 100 kpl mittauksia tai sitten niin, että tätä funktiota
   kutsutaan 100 kertaa yhden mittauksen ja sen luokittelun tekemiseksi.
   **************************************/
   struct Measurement m = readADCValue();
   int winnerIndex = calculateDistanceToAllCentrePointsAndSelectWinner(m.x, m.y, m.z);
   CM[direction][winnerIndex]++; //Kasvatetaan suunnan ja voittajan indeksin mukaista solua yhdellä
   printk("Voittaja = %d\n", winnerIndex + 1);
}

int calculateDistanceToAllCentrePointsAndSelectWinner(int x,int y,int z)
{
   /***************************************
   Tämän aliohjelma ottaa yhden kiihtyvyysanturin mittauksen x,y,z,
   laskee etäisyyden kaikkiin 6 K-means keskipisteisiin ja valitsee
   sen keskipisteen, jonka etäisyys mittaustulokseen on lyhyin.
   ***************************************/
   
   float distances[6] = {0}; //Taulukko etäisyyksien tallentamiseksi
   float minDistance = __FLT_MAX__;//Muuttuja lyhimmän etäisyyden tallentamiseksi, alustus suurimmalla float luvulla.
   int winnerIndex = 0; //Muuttuja voittajan tallentamiseksi
   
   float fx = (float)x; //Muutetaan intit floateiksi
   float fy = (float)y;
   float fz = (float)z;
   for(int i = 0; i < 6; i++)
   {
      #if DEBUG
      distances[i] = sqrt(pow(fx-CP[i][0],2) + pow(fy-CP[i][1],2) + pow(fz-CP[i][2],2));
      #else
      distances[i] = sqrt(pow(fx-centerPoints[i][0],2) + pow(fy-centerPoints[i][1],2) + pow(fz-centerPoints[i][2],2));
      #endif
      printk("Etäisyys keskipisteeseen %d = %f\n", i+1, distances[i]);

      if(distances[i] < minDistance) //Tarkistetaan onko etäisyys lyhyempi kuin aikaisempi lyhin etäisyys
      {
         minDistance = distances[i]; //Jos on niin tallennetaan uusi lyhin etäisyys
         winnerIndex = i; //Tallennetaan voittajan indeksi
      }
   }
   return winnerIndex;
}

void resetConfusionMatrix(int state)
{
	for(int i=0;i<6;i++)
	{ 
		for(int j = 0;j<6;j++)
		{
         if(state == 0)
         {
            CM[i][j]=0;
         }
         else
         {
            CM2[i][j]=0;
         }
		}
	}
}
```

## src/confusion.h
```c
#ifndef CONFUSION_MATRIX_H
#define CONFUSION_MATRIX_H

void printConfusionMatrix(void);
void makeHundredFakeClassifications(void); 
void makeOneClassificationAndUpdateConfusionMatrix(int);
int calculateDistanceToAllCentrePointsAndSelectWinner(int,int,int);
void resetConfusionMatrix(int);

//funktiot neuroniverkkoa varten
void relu(float*, int);
void softmax(float*, int);
void makeClassificationWithNeuralNetwork(int);

#endif
```

## src/keskipisteet.h
```c
#ifndef KMEANS_H
#define KMEANS_H
const int centerPoints[6][3] = {
{1219,1496,1527},
{1767,1493,1475},
{1439,1194,1516},
{1469,1771,1509},
{1471,1475,1222},
{1494,1486,1802},
};
#endif
```

## src/neuroverkonKertoimet.h
```c
#ifndef NEUROVERKONKERTOIMET_H
#define NEUROVERKONKERTOIMET_H
const float W1[3][10] = {{-0.6468954086303711,-0.08559828996658325,0.35114914178848267,0.29122045636177063,0.21185395121574402,0.36631321907043457,0.5617875456809998,-0.32339003682136536,0.03515566512942314,0.3719187080860138},
{0.3188743591308594,-0.5344238877296448,0.3537819981575012,-0.5472784042358398,-0.017668085172772408,-0.3046691417694092,0.31310662627220154,-0.49230721592903137,0.43286842107772827,-0.14105546474456787},
{-0.24774029850959778,0.08568644523620605,-0.41843149065971375,0.6083671450614929,0.10353974252939224,-0.14903491735458374,0.2084273397922516,-0.3068564236164093,-0.051542509347200394,0.5537012815475464},
};
const float B1[10] = {0.0,0.0,0.27514591813087463,-0.03603934496641159,-0.06186825782060623,0.0,0.033255480229854584,0.0,-0.3837837278842926,0.09836333990097046};
const float W2[10][6] = {{-0.25920984148979187,-0.5399588942527771,-0.6010113954544067,-0.3288375437259674,-0.28163498640060425,0.09592103958129883},
{-0.3008290231227875,0.2681770920753479,0.09546053409576416,0.19419294595718384,0.3290019631385803,-0.09705430269241333},
{0.27785801887512207,0.5435745120048523,0.32182595133781433,-0.12346970289945602,0.4110397696495056,-0.23585735261440277},
{0.048824895173311234,0.3144978880882263,0.1441432237625122,-0.6738025546073914,0.25267723202705383,0.4728856384754181},
{-0.28415152430534363,-0.3217940628528595,0.004590872675180435,-0.19804266095161438,0.18705278635025024,0.4943171739578247},
{-0.19051432609558105,-0.07036048173904419,-0.4381479024887085,-0.386063814163208,-0.3058348000049591,0.0002027750015258789},
{-0.12992750108242035,0.01625395007431507,-0.07619760930538177,0.32213717699050903,0.2946120798587799,-0.5238296985626221},
{0.5892249941825867,-0.32292523980140686,-0.43084579706192017,-0.2355947494506836,0.3257830739021301,0.4834008812904358},
{-0.0878794714808464,-0.3706715703010559,-0.5286681652069092,0.03813226893544197,-0.3040725290775299,0.25610920786857605},
{0.31344932317733765,0.0639723390340805,0.2772320508956909,-0.039600271731615067,-0.5070613026618958,0.26749688386917114},
};
const float B2[6] = {0.06815041601657867,-0.12190138548612595,0.41955411434173584,-0.1799650639295578,0.031610190868377686,-0.18966427445411682};
#endif
```
